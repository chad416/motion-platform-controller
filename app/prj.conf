## CMakeLists.txt
```
cmake_minimum_required(VERSION 3.20)
find_package(Zephyr REQUIRED HINTS $ENV{ZEPHYR_BASE})

project(motion_fw LANGUAGES C)

set(MCUE ${CMAKE_CURRENT_SOURCE_DIR}/../mcue)

target_include_directories(app PRIVATE
	${MCUE}/include
	src/hal
	src/motion
	src/proto
	src/can
	src/host
	src/sys
)

target_sources(app PRIVATE
	src/main.c
	src/hal/act_sim.c
	src/motion/motion.c
	src/proto/proto.c
	src/can/canlink.c
	src/host/host.c
	src/sys/wdt.c
	src/shell/shell_cmds.c
	${MCUE}/src/linalg.c
	${MCUE}/src/geometry.c
	${MCUE}/src/kin.c
	${MCUE}/src/workspace.c
	${MCUE}/src/filters.c
	${MCUE}/src/washout.c
	${MCUE}/src/shaping.c
	${MCUE}/src/plant.c
	${MCUE}/src/servo.c
	${MCUE}/src/ctl.c
)
```

## Kconfig
```
menu "Motion platform"

config MOTION_DEBUG_CMDS
	bool "Fault-injection shell commands (seize a leg, stall a thread)"
	default y
	help
	  Commands that deliberately break things to test the fault handling
	  and the watchdog. Disable for field builds.

endmenu

source "Kconfig.zephyr"
```

## prj.conf
```kconfig
# Kernel: 10 kHz tick for the 1 kHz servo timer
CONFIG_MAIN_STACK_SIZE=2048
CONFIG_SYS_CLOCK_TICKS_PER_SEC=10000
CONFIG_ASSERT=y
CONFIG_POLL=y

# Double-precision FPU (Cortex-M7); several threads use it
CONFIG_FPU=y
CONFIG_FPU_SHARING=y

# Drivers
CONFIG_GPIO=y
CONFIG_INPUT=y
CONFIG_CAN=y
CONFIG_HWINFO=y

# Watchdog: one task-watchdog channel per thread, IWDG as hardware fallback
CONFIG_WATCHDOG=y
CONFIG_TASK_WDT=y
CONFIG_TASK_WDT_HW_FALLBACK=y
CONFIG_REBOOT=y

# Diagnostics. Deferred logging, flushed promptly so test harnesses see events.
CONFIG_LOG=y
CONFIG_LOG_PROCESS_TRIGGER_THRESHOLD=1
CONFIG_LOG_PROCESS_THREAD_SLEEP_MS=50
CONFIG_CBPRINTF_FP_SUPPORT=y
CONFIG_SHELL=y
CONFIG_SHELL_STACK_SIZE=4096
CONFIG_SHELL_PROMPT_UART="motion:~$ "
CONFIG_BOOT_BANNER_STRING="Booting motion_fw"
```

## src/main.c
```c
/*
 * motion_fw: controller for a 6-DOF motion platform (SPEC.md).
 *
 * Start order:
 *  1. reset reason + task watchdog (if it fails, ENABLE is refused)
 *  2. motion loops (servos off: the controller starts in OFF)
 *  3. CAN and the host reports
 *
 * E-stop: SW1. A real E-stop circuit is normally closed and opens when
 * pressed; the board button is normally open, so "pressed" stands for
 * "circuit open" here. The ESTOP state latches; RESET needs the button
 * released and the platform parked.
 */
#include <zephyr/app_version.h>
#include <zephyr/input/input.h>
#include <zephyr/kernel.h>
#include <zephyr/logging/log.h>

#include "canlink.h"
#include "host.h"
#include "motion.h"
#include "wdt.h"

LOG_MODULE_REGISTER(main, LOG_LEVEL_INF);

static void on_input(struct input_event *evt, void *user_data)
{
	ARG_UNUSED(user_data);

	if ((evt->type == INPUT_EV_KEY) && (evt->code == INPUT_KEY_1)) {
		motion_set_estop(evt->value != 0);
	}
}

INPUT_CALLBACK_DEFINE(NULL, on_input, NULL);

int main(void)
{
	bool wdt_ok = wdt_init() == 0;

	LOG_INF("motion_fw %s reset=%s%s%s", APP_VERSION_STRING,
		wdt_reset_reason_name(wdt_reset_reason()),
		(wdt_last_stalled_thread()[0] != '\0') ? " thread=" : "", wdt_last_stalled_thread());

	if (motion_start(wdt_ok) != 0) {
		LOG_ERR("motion start failed");
		return 0;
	}
	if ((canlink_init() == 0) && (host_start() != 0)) {
		LOG_ERR("host reports not started");
	}
	LOG_INF("READY state=OFF");
	return 0;
}
```
