## CMakeLists.txt
```
cmake_minimum_required(VERSION 3.20)
find_package(Zephyr REQUIRED HINTS $ENV{ZEPHYR_BASE})
project(mcue_unit)

set(MCUE ${CMAKE_CURRENT_SOURCE_DIR}/../../mcue)
set(APP ${CMAKE_CURRENT_SOURCE_DIR}/../../app/src)

target_include_directories(app PRIVATE src ${MCUE}/include ${APP}/proto)

target_sources(app PRIVATE
	src/test_linalg.c
	src/test_kin.c
	src/test_workspace.c
	src/test_filters.c
	src/test_washout.c
	src/test_shaping.c
	src/test_servo.c
	src/test_ctl.c
	src/test_proto.c
	${MCUE}/src/linalg.c
	${MCUE}/src/geometry.c
	${MCUE}/src/kin.c
	${MCUE}/src/workspace.c
	${MCUE}/src/filters.c
	${MCUE}/src/washout.c
	${MCUE}/src/shaping.c
	${MCUE}/src/plant.c
	${MCUE}/src/servo.c
	${MCUE}/src/ctl.c
	${APP}/proto/proto.c
)
```

## prj.conf
```kconfig
CONFIG_ZTEST=y
# The property and round-trip tests use a lot of stack for 6x6 matrices
CONFIG_ZTEST_STACK_SIZE=8192
CONFIG_CBPRINTF_FP_SUPPORT=y
```

## src/kin_vectors.h
```c
/* GENERATED by tools/reference/gen_headers.py (NumPy reference). Do not edit. */
#ifndef KIN_VECTORS_H_
#define KIN_VECTORS_H_

struct kin_vector {
	const char *name;
	double pose[6]; /* x y z roll pitch yaw */
	double legs[6];
	double force[6]; /* statics, payload from platform.json */
};

#define KIN_VEC_L0 0.78686389354441544

static const struct kin_vector kin_vectors[] = {
	{"neutral", {0, 0, 0, 0, 0, 0}, {0.78686389354441544, 0.78686389354441544, 0.78686389354441544, 0.78686389354441544, 0.78686389354441544, 0.78686389354441544}, {918.63080971754061, 918.63080971754084, 918.63080971754107, 918.6308097175405, 918.63080971754039, 918.63080971754107}},
	{"heave +50 mm", {0, 0, 0.050000000000000003, 0, 0, 0}, {0.83165785450741536, 0.83165785450741536, 0.83165785450741536, 0.83165785450741536, 0.83165785450741536, 0.83165785450741536}, {906.19749987834916, 906.19749987834894, 906.19749987835019, 906.19749987834905, 906.1974998783495, 906.19749987834973}},
	{"surge +100 mm", {0.10000000000000001, 0, 0, 0, 0, 0}, {0.74783267595426195, 0.74783267595426195, 0.82377029933341772, 0.80598582096886207, 0.80598582096886207, 0.82377029933341772}, {1226.2250895612904, 1226.2250895612924, 183.67169884767455, 1321.5791008884994, 1321.5791008884994, 183.67169884767455}},
	{"sway -80 mm", {0, -0.080000000000000002, 0, 0, 0, 0}, {0.79933853312548619, 0.78241132621438347, 0.81687821677999028, 0.8250317112844715, 0.75526965337074847, 0.7640808549349325}, {410.1357654995756, 1425.414727726841, 953.67128149827295, 423.31877977407839, 1375.967411577099, 892.03256143424494}},
	{"roll 10 deg", {0, 0, 0, 0.17453292519943295, 0, 0}, {0.7480918279755987, 0.82534544734354953, 0.86733353430306859, 0.82731352282060733, 0.75026258115075439, 0.71355449055622222}, {1423.5934244445307, 424.89301566558271, 658.41376461238565, 1121.3995688668465, 706.94229718422093, 1218.9786890368357}},
	{"pitch -12 deg", {0, 0, 0, 0, -0.20943951023931956, 0}, {0.8717817942704128, 0.8717817942704128, 0.78686389354441544, 0.70939799631023137, 0.70939799631023148, 0.78686389354441544}, {883.6982581976182, 883.69825819761945, 406.2571744207122, 1499.6042749922635, 1499.6042749922635, 406.2571744207122}},
	{"yaw 20 deg", {0, 0, 0, 0, 0, 0.3490658503988659}, {0.76189719672979728, 0.86578946465906037, 0.76189719672979728, 0.86578946465906037, 0.76189719672979717, 0.86578946465906037}, {1885.8691812427569, -121.47996823585274, 1885.8691812427573, -121.47996823585216, 1885.8691812427567, -121.47996823585223}},
	{"combined", {0.050000000000000003, -0.040000000000000001, 0.029999999999999999, 0.069813170079773182, -0.10471975511965978, 0.13962634015954636}, {0.8066933776491616, 0.8692809364583598, 0.85411702493401742, 0.84163892672567009, 0.73825773746961554, 0.81991479110921572}, {1341.6132258657005, 787.04937230001144, 567.78487822412603, 815.84684907541043, 2001.0514026346398, -85.698735653637101}},
	{"random 0", {-0.096319555897369152, 0.041973949714546377, -0.0065463197713029747, -0.045203843631234086, -0.05064340407733596, 0.20281999709031345}, {0.83368194765002102, 0.89096268269467926, 0.71088191325399042, 0.77010876356711933, 0.7505236376261698, 0.82070541300508948}, {1255.2542520043132, -171.58812292112626, 2090.7696283134819, 261.79358187407001, 1025.239437072591, 933.55442199837159}},
	{"random 1", {0.040761241243395419, 0.075819629123725973, 0.0030307392644703529, 0.11375890550582649, -0.018018588817038633, -0.11253013611547721}, {0.76385390103522388, 0.79924154665709057, 0.85517550483258009, 0.77681222018428253, 0.82558671291899555, 0.767896020876779}, {1505.3056411696186, 562.14809541900661, 164.09777513282717, 1911.0357327762158, 173.22978812205366, 1155.6754199880734}},
	{"random 2", {-0.015689429538383759, -0.04044575966028259, -0.0609204800256892, 0.033114435936556941, -0.022579968227707081, -0.13963227166439532}, {0.77891493053219274, 0.73782173957002439, 0.78367115989816449, 0.72756785125849222, 0.72349051556572441, 0.68171979224884205}, {329.36641352967735, 1400.324421729917, 578.53841079833546, 1117.952927814709, 749.56663501142123, 1399.7002761935323}},
	{"random 3", {-0.071534086106460004, 0.060252266850256642, -0.054421604218528465, -0.0024049509662561197, 0.02793520000972613, -0.21718432868131912}, {0.80609711629014502, 0.73828834759149853, 0.73526485035428135, 0.69246984360031971, 0.82910232432244702, 0.73056552684027887}, {468.27841913139565, 933.12804463720772, 900.22299623377569, 1494.2884237618259, -471.25244619006088, 2148.8132144794927}},
	{"random 4", {0.069372197507533401, 0.014544919387389083, 0.02430065192518753, -0.044630052785642554, -0.027857807593365203, -0.0036095657494376043}, {0.8018640032304899, 0.78301885215626021, 0.8096208279892072, 0.79340401406002148, 0.82621683223096321, 0.85570183625955876}, {1096.1534497262837, 1153.8979662108993, 384.91452230189742, 1324.2568001600205, 1205.122487234265, 290.76993856323617}},
	{"random 5", {0.038504358708927183, -0.053598691363943768, 0.031159211184377839, -0.056495315584993391, 0.05884998505748415, -0.25946455513225819}, {0.8527522609190954, 0.74528997296343791, 0.87976354763135944, 0.82879381568267751, 0.87807272177157492, 0.8076410029607678}, {-251.7434596656451, 2299.4098143323599, 94.13898133760371, 1207.7587521631253, 636.27987610802552, 1346.8274930269433}},
	{"random 6", {0.047870859921852305, 0.11435585380485705, -0.028987797082292266, -0.063292980775260729, -0.065042577313621008, -0.26679127762864174}, {0.81515445025856759, 0.73184132217420872, 0.78744515447887931, 0.68075510666775196, 0.88482207764193366, 0.82173754580789893}, {951.88352849196224, 1246.7403600090722, -449.72278206084212, 2733.712685429618, -216.2957125983055, 1067.0369447992098}},
	{"random 7", {0.048955009397179339, 0.095896374431163112, -0.0053990278274022446, 0.020349630441884953, 0.16003975077812974, 0.13886898710022466}, {0.68333780506036679, 0.75623760709231136, 0.75996711415709439, 0.83852684370404318, 0.87206071991498857, 0.85532064525830798}, {2296.6031337143586, -110.81682152971497, 1227.8599680840857, 1015.4927368254508, 382.6362160946511, 634.60156963058955}},
	{"random 8", {-0.046864336199431686, 0.056638411713914316, 0.020880121160521153, -0.031638967807965379, -0.1390378999300951, -0.10259154685786667}, {0.90075368741069373, 0.86491840988953628, 0.77760873203570557, 0.70325816782115413, 0.80490411973552911, 0.81662632031341198}, {702.51421619269274, 761.44857849559992, 691.85702508410179, 1636.2492499329435, 468.22992160760703, 1188.2901374780849}},
	{"random 9", {0.13904542443614362, -0.08504294951616044, -0.077272401282364886, -0.046188594129443511, -0.13928397912900722, -0.16252580566467253}, {0.77827180305174504, 0.698679583242513, 0.84020406194998176, 0.72265923855933745, 0.695671841501458, 0.73607520505710577}, {513.41801206415346, 2215.087477682473, -1201.0846976805792, 2115.4318934925236, 2082.7128702830159, -179.96758560668181}},
	{"random 10", {0.12433683663087738, -0.054365375566326146, 0.017177902909365161, -0.091195275695794012, 0.058636055160101286, -0.25994487936068689}, {0.81245533313096385, 0.69821583970397072, 0.89959983183138104, 0.83608551174762291, 0.88663710455819356, 0.83225325616042101}, {-32.259571041828018, 2624.0274350801633, -582.01384201845769, 1523.741222892678, 976.80564249458939, 760.41266903789722}},
	{"random 11", {0.086942814982651467, -0.023116186568522157, -0.063267922581713737, 0.090146104248228248, 0.018948180647350654, -0.043182929140466675}, {0.67667669731172908, 0.69923255956299102, 0.82093743469804648, 0.78004914359534738, 0.73200052722461872, 0.71069749967565132}, {1174.6233401510883, 1242.5353942986665, 82.944382031020737, 1303.7866289511485, 1194.6686523789913, 593.52021318312472}},
};

struct ws_vector {
	const char *name;
	double cmd[6];
	double scale; /* from the reference bisection */
};

static const struct ws_vector ws_vectors[] = {
	{"surge 0.5 m", {0.5, 0, 0, 0, 0, 0}, 0.51611328125},
	{"pitch 30 deg + heave", {0, 0, 0.080000000000000002, 0, 0.52359877559829882, 0}, 0.41259765625},
	{"everything", {0.29999999999999999, 0.29999999999999999, 0.20000000000000001, 0.3490658503988659, 0.3490658503988659, 0.69813170079773179}, 0.269775390625},
	{"yaw 60 deg", {0, 0, 0, 0, 0, 1.0471975511965976}, 0.4482421875},
};

#endif /* KIN_VECTORS_H_ */
```

## src/proto_vectors.h
```c
/* GENERATED by protocol/gen_vectors.py from protocol/motion.dbc. Do not edit. */
#ifndef MOTION_PROTO_VECTORS_H_
#define MOTION_PROTO_VECTORS_H_

#include <stdint.h>

/* VEHICLE_F (ID 0x100): {"f_x": 1.5, "f_y": -2.25, "f_z": 9.81, "seq": 42} */
#define VEC_VEHICLE_F_ID 0x100
static const uint8_t VEC_VEHICLE_F[8] = {0xEE, 0x02, 0x9B, 0xFB, 0x29, 0x13, 0x2A, 0x00};

/* VEHICLE_W (ID 0x101): {"w_x": 0.125, "w_y": -0.05, "w_z": 0.3, "seq": 65535} */
#define VEC_VEHICLE_W_ID 0x101
static const uint8_t VEC_VEHICLE_W[8] = {0xE2, 0x04, 0x0C, 0xFE, 0xB8, 0x0B, 0xFF, 0xFF};

/* CMD (ID 0x10F): {"isotp_pci": 6, "opcode": 5, "key": 1, "value": 450} */
#define VEC_CMD_SET_ID 0x10F
static const uint8_t VEC_CMD_SET[7] = {0x06, 0x05, 0x01, 0xC2, 0x01, 0x00, 0x00};

/* CMD (ID 0x10F): {"isotp_pci": 6, "opcode": 5, "key": 2, "value": -1} */
#define VEC_CMD_NEG_ID 0x10F
static const uint8_t VEC_CMD_NEG[7] = {0x06, 0x05, 0x02, 0xFF, 0xFF, 0xFF, 0xFF};

/* CMD_ACK (ID 0x18F): {"isotp_pci": 7, "opcode": 6, "key": 1, "status": 0, "value": 450} */
#define VEC_CMD_ACK_ID 0x18F
static const uint8_t VEC_CMD_ACK[8] = {0x07, 0x06, 0x01, 0x00, 0xC2, 0x01, 0x00, 0x00};

/* FAULT (ID 0x180): {"code": 1, "leg": 3, "state": 6, "count": 2, "value": -5123} */
#define VEC_FAULT_ID 0x180
static const uint8_t VEC_FAULT[8] = {0x01, 0x03, 0x06, 0x02, 0xFD, 0xEB, 0xFF, 0xFF};

/* STATUS (ID 0x181): {"state": 4, "saturated": 1, "fk_ok": 1, "estop": 0, "comms_lost": 1, "descended": 0, "fault": 0, "fault_leg": 0, "ws_scale": 0.41, "event": 7, "seq": 1000} */
#define VEC_STATUS_ID 0x181
static const uint8_t VEC_STATUS[8] = {0x04, 0x0B, 0x00, 0x00, 0x52, 0x07, 0xE8, 0x03};

/* POSE_T (ID 0x182): {"x": 0.0825, "y": -0.0005, "z": 0.07, "seq": 5} */
#define VEC_POSE_T_ID 0x182
static const uint8_t VEC_POSE_T[8] = {0x39, 0x03, 0xFB, 0xFF, 0xBC, 0x02, 0x05, 0x00};

/* POSE_R (ID 0x183): {"roll": 5.25, "pitch": -8.75, "yaw": 2.5, "seq": 5} */
#define VEC_POSE_R_ID 0x183
static const uint8_t VEC_POSE_R[8] = {0x0D, 0x02, 0x95, 0xFC, 0xFA, 0x00, 0x05, 0x00};

/* LEG_POS_A (ID 0x184): {"stroke_1": 0.01, "stroke_2": 0.125, "stroke_3": 0.24, "seq": 7} */
#define VEC_LEG_POS_A_ID 0x184
static const uint8_t VEC_LEG_POS_A[8] = {0xE8, 0x03, 0xD4, 0x30, 0xC0, 0x5D, 0x07, 0x00};

/* LEG_CUR_B (ID 0x187): {"current_4": 2.95, "current_5": -0.97, "current_6": 20.0, "seq": 7} */
#define VEC_LEG_CUR_B_ID 0x187
static const uint8_t VEC_LEG_CUR_B[8] = {0x27, 0x01, 0x9F, 0xFF, 0xD0, 0x07, 0x07, 0x00};

/* TIMING (ID 0x188): {"servo_max_us": 312, "cue_max_us": 1450, "servo_overruns": 0, "cue_overruns": 2} */
#define VEC_TIMING_ID 0x188
static const uint8_t VEC_TIMING[8] = {0x38, 0x01, 0xAA, 0x05, 0x00, 0x00, 0x02, 0x00};

#endif /* MOTION_PROTO_VECTORS_H_ */
```

## src/test_ctl.c
```c
/*
 * SPEC F08, F11-F13, P02, P06: the controller core against six simulated
 * actuators, at the firmware rates (cueing 500 Hz, servo 1 kHz). These are the
 * unit-level twins of the Renode tests IT01-IT08.
 */
#include <math.h>
#include <string.h>
#include <zephyr/ztest.h>

#include "mcue/ctl.h"
#include "mcue/kin.h"
#include "mcue/plant.h"

#define DEG (MC_PI / 180.0)

struct sim {
	mc_geometry g;
	mc_ctl c;
	mc_servo_bank b;
	mc_plant pl[MC_LEGS];
	mc_servo_cmd cmd;
	mc_pose true_pose;
	bool estop;
	bool overrun;
	double t;
	/* vehicle input */
	bool streaming;
	bool repeat_seq; /* a host stuck on one frame: the sequence number does not advance */
	uint16_t seq;
	double f[3], w[3];
	int step_no;
	/* records */
	double max_speed;  /* true leg speed, m/s, since cleared */
};

static struct sim S;

static void loads(struct sim *s, double load[MC_LEGS])
{
	double l[MC_LEGS];
	mc_fk_info info;

	for (int i = 0; i < MC_LEGS; i++) {
		l[i] = mc_plant_length(&s->pl[i]);
	}
	(void)mc_fk(&s->g, l, &s->true_pose, 30, 1e-12, &info);
	zassert_true(info.converged);
	zassert_true(mc_statics(&s->g, &s->true_pose, 500.0, &s->c.p.com, load));
}

static void sim_init(struct sim *s)
{
	mc_geometry_params gp;
	mc_ctl_params cp;
	mc_washout_params wp;
	mc_plant_params pp;
	mc_servo_params sp;

	(void)memset(s, 0, sizeof(*s));
	mc_geometry_default_params(&gp);
	zassert_true(mc_geometry_build(&s->g, &gp));
	mc_ctl_default_params(&cp, &s->g);
	mc_washout_default_params(&wp);
	zassert_true(mc_ctl_init(&s->c, &s->g, &cp, &wp));
	mc_plant_default_params(&pp, &s->g);
	mc_servo_default_params(&sp, &pp);
	mc_bank_init(&s->b, &sp, &cp);
	for (int i = 0; i < MC_LEGS; i++) {
		/* power-up: resting on the lower stops */
		mc_plant_init(&s->pl[i], &pp, s->g.l_min);
	}
	s->f[2] = MC_GRAVITY;
	for (int i = 0; i < MC_LEGS; i++) {
		s->b.fb.pos[i] = mc_plant_encoder(&s->pl[i]);
	}
}

/* One cueing period: controller, then two servo periods. */
static void sim_step(struct sim *s)
{
	double load[MC_LEGS];

	if (s->streaming && ((s->step_no % 5) == 0)) {
		(void)mc_ctl_vehicle(&s->c, s->f, s->w, s->seq);
		if (!s->repeat_seq) {
			s->seq++;
		}
	}
	s->step_no++;
	mc_ctl_step(&s->c, &s->b.fb, s->estop, s->overrun, &s->cmd);
	loads(s, load);
	for (int k = 0; k < 2; k++) {
		double pos[MC_LEGS], cur[MC_LEGS];

		for (int i = 0; i < MC_LEGS; i++) {
			pos[i] = mc_plant_encoder(&s->pl[i]);
		}
		mc_bank_step(&s->b, &s->cmd, pos, cur);
		for (int i = 0; i < MC_LEGS; i++) {
			mc_plant_step(&s->pl[i], cur[i], load[i]);
			s->max_speed = fmax(s->max_speed, fabs(mc_plant_speed(&s->pl[i])));
		}
	}
	s->t += s->c.dt;
}

static void run(struct sim *s, double seconds)
{
	int n = (int)lround(seconds / s->c.dt);

	for (int k = 0; k < n; k++) {
		sim_step(s);
	}
}

/* Run until the state is reached; returns the time it took. */
static double run_until(struct sim *s, mc_state st, double timeout)
{
	double t0 = s->t;

	while (s->c.state != st) {
		zassert_true((s->t - t0) < timeout, "no %s after %.2f s (state %s, fault %s)",
			     mc_state_name(st), timeout, mc_state_name(s->c.state),
			     mc_fault_name(s->c.fault));
		sim_step(s);
	}
	return s->t - t0;
}

static double max_leg_error(const struct sim *s, const double target[MC_LEGS])
{
	double e = 0.0;

	for (int i = 0; i < MC_LEGS; i++) {
		e = fmax(e, fabs(mc_plant_length(&s->pl[i]) - target[i]));
	}
	return e;
}

static void engage(struct sim *s)
{
	run(s, 0.01);
	zassert_equal(mc_ctl_command(&s->c, MC_CMD_ENABLE), MC_CST_OK);
	(void)run_until(s, MC_ST_PARKED, 2.0);
	s->streaming = true;
	zassert_equal(mc_ctl_command(&s->c, MC_CMD_ENGAGE), MC_CST_OK);
	(void)run_until(s, MC_ST_ENGAGED, 3.5);
}

static void *setup(void)
{
	return NULL;
}

static void before(void *f)
{
	ARG_UNUSED(f);
	sim_init(&S);
}

ZTEST_SUITE(ctl, NULL, setup, before, NULL, NULL);

/* IT01 twin: OFF with the servos off, ENABLE -> HOMING -> PARKED. */
ZTEST(ctl, test_boot_enable_homes_to_park)
{
	run(&S, 0.5);
	zassert_equal(S.c.state, MC_ST_OFF);
	zassert_false(S.cmd.on);
	zassert_within(max_leg_error(&S, (double[MC_LEGS]){S.g.l_min, S.g.l_min, S.g.l_min,
							    S.g.l_min, S.g.l_min, S.g.l_min}),
		       0.0, 1e-12, "legs moved while OFF");

	zassert_equal(mc_ctl_command(&S.c, MC_CMD_ENGAGE), MC_CST_BAD_STATE);
	zassert_equal(mc_ctl_command(&S.c, MC_CMD_ENABLE), MC_CST_OK);
	zassert_equal(S.c.state, MC_ST_HOMING);
	S.max_speed = 0.0;
	double t = run_until(&S, MC_ST_PARKED, 2.0);

	run(&S, 0.2);
	double e = max_leg_error(&S, S.c.p.park);

	TC_PRINT("homing: %.3f s, leg error at park %.4f mm, max speed %.4f m/s\n", t, e * 1e3,
		 S.max_speed);
	zassert_true(e < 1e-4);
	zassert_true(S.max_speed <= S.c.p.descent_speed * 1.02);
	zassert_equal(mc_ctl_command(&S.c, MC_CMD_ENABLE), MC_CST_BAD_STATE);
}

/* IT02 twin: ENGAGE -> neutral within 3.5 s; FK pose ~ 0; PARK -> PARKED. */
ZTEST(ctl, test_engage_and_park)
{
	run(&S, 0.01);
	zassert_equal(mc_ctl_command(&S.c, MC_CMD_ENABLE), MC_CST_OK);
	(void)run_until(&S, MC_ST_PARKED, 2.0);
	S.streaming = true;
	zassert_equal(mc_ctl_command(&S.c, MC_CMD_ENGAGE), MC_CST_OK);
	double t = run_until(&S, MC_ST_ENGAGED, 3.5);

	run(&S, 0.5);
	const mc_pose *q = &S.c.pose;

	TC_PRINT("engage: %.3f s; FK pose %.4f %.4f %.4f mm, %.4f %.4f %.4f deg\n", t, q->x * 1e3,
		 q->y * 1e3, q->z * 1e3, q->roll / DEG, q->pitch / DEG, q->yaw / DEG);
	zassert_true(S.c.fk_ok);
	zassert_true(fabs(q->x) < 5e-4 && fabs(q->y) < 5e-4 && fabs(q->z) < 5e-4);
	zassert_true(fabs(q->roll) < 0.05 * DEG && fabs(q->pitch) < 0.05 * DEG &&
		     fabs(q->yaw) < 0.05 * DEG);

	zassert_equal(mc_ctl_command(&S.c, MC_CMD_PARK), MC_CST_OK);
	t = run_until(&S, MC_ST_PARKED, 4.0);
	run(&S, 0.2);
	TC_PRINT("park: %.3f s\n", t);
	zassert_true(max_leg_error(&S, S.c.p.park) < 1e-4);
}

/* IT03 twin: sustained surge -> washout with tilt; tracking (P02) with the servos. */
ZTEST(ctl, test_surge_step_cueing_and_tracking)
{
	engage(&S);
	S.c.cmd.stats_epoch++;
	S.f[0] = 3.0;
	double prev_pitch = S.c.pose.pitch, max_rate = 0.0, peak_x = 0.0;

	for (int k = 0; k < 4000; k++) { /* 8 s */
		sim_step(&S);
		max_rate = fmax(max_rate, fabs(S.c.pose.pitch - prev_pitch) / S.c.dt);
		prev_pitch = S.c.pose.pitch;
		peak_x = fmax(peak_x, S.c.pose.x);
	}
	double rms[MC_LEGS], peak[MC_LEGS], worst_rms = 0.0, worst_peak = 0.0;

	mc_bank_tracking(&S.b, rms, peak);
	for (int i = 0; i < MC_LEGS; i++) {
		worst_rms = fmax(worst_rms, rms[i]);
		worst_peak = fmax(worst_peak, peak[i]);
	}
	TC_PRINT("surge 3 m/s^2: peak x %.1f mm, x after 8 s %.2f mm, pitch %.3f deg, "
		 "max pitch rate (FK) %.3f deg/s; tracking rms %.4f mm, peak %.4f mm\n",
		 peak_x * 1e3, S.c.pose.x * 1e3, S.c.pose.pitch / DEG, max_rate / DEG,
		 worst_rms * 1e3, worst_peak * 1e3);
	zassert_equal(S.c.state, MC_ST_ENGAGED);
	zassert_within(S.c.pose.pitch, -asin(1.5 / MC_GRAVITY), 0.02 * DEG);
	zassert_true(fabs(S.c.pose.x) < 0.005);
	/* P04 on the measured pose: the 3 deg/s limit plus servo and encoder ripple */
	zassert_true(max_rate < 3.1 * DEG, "%g deg/s", max_rate / DEG);
	zassert_true(worst_rms < 0.001 && worst_peak < 0.003);
}

/* IT06 twin, P06: E-stop while moving -> standstill <= 0.5 s, descent <= 0.05 m/s. */
ZTEST(ctl, test_estop_stops_then_descends)
{
	engage(&S);
	S.f[0] = 5.0; /* hard surge onset and a bump: legs moving fast */
	S.f[2] = MC_GRAVITY + 3.0;
	run(&S, 0.25);

	double v_before = 0.0;

	for (int i = 0; i < MC_LEGS; i++) {
		v_before = fmax(v_before, fabs(mc_plant_speed(&S.pl[i])));
	}
	S.estop = true;
	sim_step(&S);
	zassert_equal(S.c.state, MC_ST_ESTOP);
	zassert_equal(S.c.fault, MC_FAULT_ESTOP);

	/* standstill: every leg slower than 1 mm/s, and it stays still until the descent */
	double t_stop = -1.0, v_dwell = 0.0;

	for (int k = 0; k < 500 && S.c.phase != MC_PH_TRAJ; k++) {
		sim_step(&S);
		double v = 0.0;

		for (int i = 0; i < MC_LEGS; i++) {
			v = fmax(v, fabs(mc_plant_speed(&S.pl[i])));
		}
		if ((v < 0.001) && (t_stop < 0.0)) {
			t_stop = (k + 1) * S.c.dt;
		}
		if (t_stop > 0.0) {
			v_dwell = fmax(v_dwell, v);
		}
	}
	TC_PRINT("standstill held at <= %.5f m/s until the descent\n", v_dwell);
	zassert_equal(S.c.phase, MC_PH_TRAJ);
	zassert_true(v_dwell < 0.001);
	S.estop = false; /* the button is released; the state stays latched */
	S.max_speed = 0.0;
	sim_step(&S);
	zassert_equal(S.c.state, MC_ST_ESTOP);
	zassert_equal(mc_ctl_command(&S.c, MC_CMD_RESET_FAULT), MC_CST_BAD_STATE, "not parked");
	while (!S.c.descended) {
		sim_step(&S);
	}
	run(&S, 0.2);
	TC_PRINT("E-stop at %.3f m/s leg speed: standstill after %.0f ms; descent max speed "
		 "%.4f m/s\n",
		 v_before, t_stop * 1e3, S.max_speed);
	zassert_true(v_before > 0.01, "legs were not moving");
	zassert_true((t_stop > 0.0) && (t_stop <= 0.5));
	zassert_true(S.max_speed <= 0.05 * 1.01, "descent %g m/s", S.max_speed);
	zassert_equal(S.c.state, MC_ST_ESTOP);
	zassert_true(max_leg_error(&S, S.c.p.park) < 1e-4);

	S.estop = true;
	sim_step(&S);
	zassert_equal(mc_ctl_command(&S.c, MC_CMD_RESET_FAULT), MC_CST_ESTOP);
	S.estop = false;
	sim_step(&S);
	zassert_equal(mc_ctl_command(&S.c, MC_CMD_RESET_FAULT), MC_CST_OK);
	zassert_equal(S.c.state, MC_ST_PARKED);
	zassert_equal(mc_ctl_command(&S.c, MC_CMD_ENGAGE), MC_CST_OK);
}

/* IT07 twin, F12: VEHICLE_STATE stops -> COMMS_LOST, washout to neutral, PARKING. */
ZTEST(ctl, test_heartbeat_loss_washes_out_then_parks)
{
	engage(&S);
	S.f[0] = 3.0;
	run(&S, 4.0);
	uint32_t events = S.c.event_count;

	S.streaming = false;
	double t = 0.0;

	while (!S.c.comms_lost) {
		sim_step(&S);
		t += S.c.dt;
		zassert_true(t < 0.3);
	}
	TC_PRINT("comms lost detected %.0f ms after the last sample\n", t * 1e3);
	zassert_true(t > 0.19 && t <= 0.2 + 2 * S.c.dt);
	zassert_equal(S.c.event, MC_FAULT_COMMS_LOST);
	zassert_equal(S.c.event_count, events + 1);
	zassert_equal(S.c.state, MC_ST_ENGAGED, "washes out first");

	double t_park = run_until(&S, MC_ST_PARKING, 11.0);

	TC_PRINT("washed out to neutral after %.2f s, pitch %.3f deg\n", t_park,
		 S.c.cue_pose.pitch / DEG);
	(void)run_until(&S, MC_ST_PARKED, 4.0);
	zassert_equal(S.c.fault, MC_FAULT_NONE, "comms loss is not a latched fault");
}

/* IT08 twin, F13: a seized leg -> following-error fault -> controlled descent. */
ZTEST(ctl, test_seized_leg_faults_and_descends)
{
	engage(&S);
	S.f[1] = 3.0;
	run(&S, 0.3);
	S.pl[2].stuck = true;
	double t = 0.0, t_exceed = -1.0;

	while (S.c.state != MC_ST_FAULT) {
		if ((t_exceed < 0.0) && (fabs(S.b.fb.ferr[2]) > 0.005)) {
			t_exceed = t;
		}
		sim_step(&S);
		t += S.c.dt;
		zassert_true(t < 3.0, "no fault");
	}
	TC_PRINT("seized leg 3: error over 5 mm after %.0f ms, FAULT %s leg %d after %.0f ms\n",
		 t_exceed * 1e3, mc_fault_name(S.c.fault), S.c.fault_leg + 1, t * 1e3);
	zassert_equal(S.c.fault, MC_FAULT_FOLLOWING);
	zassert_equal(S.c.fault_leg, 2);
	zassert_true((t - t_exceed) <= 0.060);

	S.max_speed = 0.0;
	while (!S.c.descended) {
		sim_step(&S);
	}
	run(&S, 0.2);
	double seized_at = mc_plant_length(&S.pl[2]);

	TC_PRINT("descent max speed %.4f m/s; seized leg left at %.1f mm above park, drawing "
		 "%.2f A\n",
		 S.max_speed, (seized_at - S.c.p.park[2]) * 1e3, S.b.fb.current[2]);
	zassert_true(S.max_speed <= 0.05 * 1.01);
	/* released: only the gravity feed-forward, no fight at the current limit */
	zassert_true(fabs(S.b.fb.current[2]) < 5.0, "%g A", S.b.fb.current[2]);
	zassert_true(max_leg_error(&S, S.c.p.park) > 0.001, "seized leg cannot be at park");

	/* freed: RESET re-homes from where the legs are, at the descent speed */
	S.pl[2].stuck = false;
	S.max_speed = 0.0;
	zassert_equal(mc_ctl_command(&S.c, MC_CMD_RESET_FAULT), MC_CST_OK);
	zassert_equal(S.c.state, MC_ST_HOMING);
	(void)run_until(&S, MC_ST_PARKED, 10.0);
	run(&S, 0.2);
	zassert_true(max_leg_error(&S, S.c.p.park) < 1e-4);
	zassert_true(S.max_speed <= 0.05 * 1.01, "%g m/s", S.max_speed);
}

/* F13: a leg outside its hard limits (here: forced past the upper one). */
ZTEST(ctl, test_hard_limit_fault)
{
	engage(&S);
	S.pl[4].theta = (S.c.p.hard_hi + 0.001 - S.g.l_min) / (S.pl[4].p.lead / (2.0 * MC_PI));
	run(&S, 0.01);
	zassert_equal(S.c.state, MC_ST_FAULT);
	zassert_equal(S.c.fault, MC_FAULT_HARD_LIMIT);
	zassert_equal(S.c.fault_leg, 4);
}

/* F13: current saturated for 500 ms (the error stays under the following limit). */
ZTEST(ctl, test_current_saturation_trips_after_500ms)
{
	mc_servo_bank *b = &S.b;
	mc_servo_cmd cmd = {.seq = 1, .on = true};
	double pos[MC_LEGS], cur[MC_LEGS];
	int k;

	for (int i = 0; i < MC_LEGS; i++) {
		pos[i] = S.g.l0;
		cmd.prev[i] = S.g.l0;
		cmd.next[i] = S.g.l0;
	}
	cmd.prev[1] = S.g.l0 + 0.004;
	cmd.next[1] = S.g.l0 + 0.004;
	for (k = 0; k < 2000 && b->fb.trip == 0; k++) {
		mc_bank_step(b, &cmd, pos, cur); /* leg 2 blocked 4 mm short */
	}
	TC_PRINT("blocked leg: CURRENT trip after %d ms at %.1f A\n", k, b->fb.trip_value);
	zassert_equal(b->fb.trip, MC_FAULT_CURRENT);
	zassert_equal(b->fb.trip_leg, 1);
	zassert_true(k >= 500 && k <= 560, "%d ms", k);
}

ZTEST(ctl, test_overrun_faults)
{
	engage(&S);
	S.overrun = true;
	sim_step(&S);
	zassert_equal(S.c.state, MC_ST_FAULT);
	zassert_equal(S.c.fault, MC_FAULT_OVERRUN);
}

ZTEST(ctl, test_implausible_encoder_at_enable)
{
	run(&S, 0.01);
	/* 3.2 mm below the stop: impossible (stuck keeps the model from clamping it) */
	S.pl[0].theta = -2.0;
	S.pl[0].stuck = true;
	run(&S, 0.01);
	zassert_equal(mc_ctl_command(&S.c, MC_CMD_ENABLE), MC_CST_OK);
	zassert_equal(S.c.state, MC_ST_FAULT);
	zassert_equal(S.c.fault, MC_FAULT_HOMING);
	zassert_false(S.cmd.on);
	zassert_equal(mc_ctl_command(&S.c, MC_CMD_RESET_FAULT), MC_CST_OK);
	zassert_equal(S.c.state, MC_ST_OFF);
}

ZTEST(ctl, test_estop_blocks_enable)
{
	S.estop = true;
	run(&S, 0.01);
	zassert_equal(mc_ctl_command(&S.c, MC_CMD_ENABLE), MC_CST_ESTOP);
	zassert_equal(S.c.state, MC_ST_OFF);
}

ZTEST(ctl, test_params)
{
	int32_t v;

	zassert_equal(mc_ctl_get_param(&S.c, MC_PARAM_FORCE_GAIN, &v), MC_CST_OK);
	zassert_equal(v, 500);
	zassert_equal(mc_ctl_get_param(&S.c, MC_PARAM_TILT_RATE_LIMIT, &v), MC_CST_OK);
	zassert_equal(v, 3000);
	zassert_equal(mc_ctl_set_param(&S.c, MC_PARAM_FORCE_GAIN, 450), MC_CST_OK);
	zassert_equal(mc_ctl_get_param(&S.c, MC_PARAM_FORCE_GAIN, &v), MC_CST_OK);
	zassert_equal(v, 450);
	zassert_within(S.c.wo.p.force_gain, 0.45, 1e-15);
	zassert_equal(mc_ctl_set_param(&S.c, MC_PARAM_FORCE_GAIN, 1500), MC_CST_BAD_VALUE);
	zassert_equal(mc_ctl_set_param(&S.c, 99, 1), MC_CST_BAD_KEY);
	zassert_equal(mc_ctl_get_param(&S.c, 99, &v), MC_CST_BAD_KEY);
	engage(&S);
	zassert_equal(mc_ctl_set_param(&S.c, MC_PARAM_FORCE_GAIN, 400), MC_CST_BAD_STATE);
	zassert_equal(mc_ctl_get_param(&S.c, MC_PARAM_FORCE_GAIN, &v), MC_CST_OK);
	zassert_equal(v, 450);
}

/* F09: 100 Hz samples are interpolated linearly over five cueing steps. */
ZTEST(ctl, test_input_interpolation)
{
	engage(&S);
	S.streaming = false;
	double f0[3] = {0.0, 0.0, MC_GRAVITY}, f1[3] = {1.0, -2.0, MC_GRAVITY + 0.5};
	double w0[3] = {0}, w1[3] = {0.1, 0.0, -0.05};

	zassert_true(mc_ctl_vehicle(&S.c, f0, w0, S.seq++));
	run(&S, 0.01);
	zassert_true(mc_ctl_vehicle(&S.c, f1, w1, S.seq++));
	for (int k = 1; k <= 6; k++) {
		sim_step(&S);
		double u = fmin(1.0, k / 5.0);

		zassert_within(S.c.in_now[0], u * 1.0, 1e-12);
		zassert_within(S.c.in_now[1], u * -2.0, 1e-12);
		zassert_within(S.c.in_now[2], MC_GRAVITY + (u * 0.5), 1e-12);
		zassert_within(S.c.in_now[5], u * -0.05, 1e-12);
	}
}

/* F12: a host that keeps sending the same frame is not alive. */
ZTEST(ctl, test_repeated_sequence_number_is_not_a_heartbeat)
{
	engage(&S);
	S.f[0] = 1.0;
	run(&S, 1.0);
	zassert_false(S.c.comms_lost);
	S.repeat_seq = true; /* frames keep coming every 10 ms, all with one seq */
	double t = 0.0;

	while (!S.c.comms_lost) {
		sim_step(&S);
		t += S.c.dt;
		zassert_true(t < 0.3, "repeated frames kept the heartbeat alive");
	}
	TC_PRINT("repeated seq: comms lost after %.0f ms, %u stale samples\n", t * 1e3,
		 S.c.stale_samples);
	zassert_true(t > 0.19 && t <= 0.2 + 2 * S.c.dt);
	zassert_true(S.c.stale_samples >= 19);
	zassert_equal(S.c.event, MC_FAULT_COMMS_LOST);
}

/* The sequence number may wrap; it must still advance, and an older one is refused. */
ZTEST(ctl, test_sequence_number_wraps_and_old_samples_are_refused)
{
	const double f[3] = {0.0, 0.0, MC_GRAVITY}, w[3] = {0};

	zassert_true(mc_ctl_vehicle(&S.c, f, w, 65534U)); /* first sample: any seq */
	zassert_true(mc_ctl_vehicle(&S.c, f, w, 65535U));
	zassert_true(mc_ctl_vehicle(&S.c, f, w, 0U));     /* wrapped */
	zassert_false(mc_ctl_vehicle(&S.c, f, w, 0U));    /* repeated */
	zassert_false(mc_ctl_vehicle(&S.c, f, w, 65000U)); /* older */
	zassert_true(mc_ctl_vehicle(&S.c, f, w, 3U));     /* a gap is fine */
	zassert_equal(S.c.stale_samples, 2U);
}

/* The firmware refuses to move if its task watchdog did not start. */
ZTEST(ctl, test_inhibit_refuses_enable)
{
	run(&S, 0.01);
	mc_ctl_inhibit(&S.c, true);
	zassert_equal(mc_ctl_command(&S.c, MC_CMD_ENABLE), MC_CST_BAD_STATE);
	zassert_equal(S.c.state, MC_ST_OFF);
	run(&S, 0.1);
	zassert_false(S.cmd.on, "servos must stay off");
	mc_ctl_inhibit(&S.c, false);
	zassert_equal(mc_ctl_command(&S.c, MC_CMD_ENABLE), MC_CST_OK);
}

/*
 * A stop point clamped to the soft limit can sit a few um short of where the
 * shaper is able to land exactly (it brakes for |e| - a dt^2 / 8). The stop
 * ends on a tolerance, not on exact equality, so it cannot hang there.
 */
ZTEST(ctl, test_stop_ends_on_a_tolerance)
{
	engage(&S);
	S.c.sp[0] = S.g.soft_hi - 2e-6;
	S.c.sp_vel[0] = 0.0;
	int k;

	for (k = 0; k < 50; k++) {
		mc_ctl_step(&S.c, &S.b.fb, k == 0, false, &S.cmd); /* E-stop on the first step */
		if (S.c.phase != MC_PH_STOP) {
			break;
		}
	}
	TC_PRINT("clamped stop point: stop ended after %d steps, leg 1 %.1f um from it\n", k + 1,
		 (S.c.stop_target[0] - S.c.sh.pos[0]) * 1e6);
	zassert_equal(S.c.state, MC_ST_ESTOP);
	zassert_equal(S.c.phase, MC_PH_DWELL);
	zassert_equal(S.c.stop_target[0], S.g.soft_hi, "stop point clamped to the soft limit");
	zassert_true(S.c.sh.pos[0] != S.c.stop_target[0], "exact equality would never come");
}

/* A stop that does not finish within 0.5 s while PARKING raises a FAULT and descends. */
ZTEST(ctl, test_stop_timeout_while_parking_faults)
{
	engage(&S);
	S.f[1] = 3.0;
	run(&S, 0.3);
	zassert_equal(mc_ctl_command(&S.c, MC_CMD_PARK), MC_CST_OK);
	zassert_equal(S.c.phase, MC_PH_STOP);
	S.c.sh.lim.a_max = 0.001; /* a broken stop: it would take seconds */
	double t = run_until(&S, MC_ST_FAULT, 0.6);

	TC_PRINT("stop timeout: FAULT %s after %.0f ms\n", mc_fault_name(S.c.fault), t * 1e3);
	zassert_equal(S.c.fault, MC_FAULT_INTERNAL);
	zassert_true(t > 0.5);
	while (S.c.phase != MC_PH_TRAJ) { /* the FAULT stop (normal limits), then the standstill */
		sim_step(&S);
		zassert_true(S.t < 30.0, "no descent");
	}
	S.max_speed = 0.0;
	while (!S.c.descended) {
		sim_step(&S);
		zassert_true(S.t < 30.0, "no descent");
	}
	zassert_true(S.max_speed <= 0.05, "descent %g m/s", S.max_speed);
	zassert_true(max_leg_error(&S, S.c.p.park) < 1e-3);
}

/* While halting, a second leg that seizes is reported and released too. */
ZTEST(ctl, test_second_leg_trip_during_descent)
{
	engage(&S);
	S.f[1] = 3.0; /* the legs must move for a seized one to fall behind */
	run(&S, 0.3);
	S.pl[2].stuck = true;
	(void)run_until(&S, MC_ST_FAULT, 3.0);
	zassert_equal(S.c.fault, MC_FAULT_FOLLOWING);
	zassert_equal(S.c.fault_leg, 2);
	uint32_t events = S.c.event_count;

	while (S.c.phase != MC_PH_TRAJ) { /* stop and standstill done: the descent starts */
		sim_step(&S);
		zassert_true(S.t < 10.0);
	}
	run(&S, 0.2);
	S.pl[4].stuck = true;
	double t = 0.0;

	while (S.c.event_count == events) {
		sim_step(&S);
		t += S.c.dt;
		zassert_true(t < 1.0, "second trip never reported");
	}
	run(&S, 0.05);
	TC_PRINT("second seized leg: %s on leg %d reported %.0f ms later; %.2f A on it\n",
		 mc_fault_name(S.c.event), S.c.event_leg + 1, t * 1e3, S.b.fb.current[4]);
	/* early in the slow descent the current monitor (500 ms) can beat the 5 mm error */
	zassert_true((S.c.event == MC_FAULT_FOLLOWING) || (S.c.event == MC_FAULT_CURRENT));
	zassert_equal(S.c.event_leg, 4);
	zassert_equal(S.c.fault, MC_FAULT_FOLLOWING, "the first fault stays latched");
	zassert_equal(S.c.fault_leg, 2);
	zassert_true(S.cmd.released[2] && S.cmd.released[4]);
	zassert_true(fabs(S.b.fb.current[4]) < 5.0, "%g A", S.b.fb.current[4]);
}

/* While halting, a leg that leaves its hard limits is reported (the fault stays ESTOP). */
ZTEST(ctl, test_hard_limit_reported_while_halting)
{
	engage(&S);
	S.estop = true;
	sim_step(&S);
	zassert_equal(S.c.state, MC_ST_ESTOP);
	uint32_t events = S.c.event_count;

	S.pl[0].theta = (S.c.p.hard_hi + 0.001 - S.g.l_min) / (S.pl[0].p.lead / (2.0 * MC_PI));
	sim_step(&S);
	sim_step(&S);
	zassert_equal(S.c.event_count, events + 1);
	zassert_equal(S.c.event, MC_FAULT_HARD_LIMIT);
	zassert_equal(S.c.event_leg, 0);
	zassert_equal(S.c.state, MC_ST_ESTOP);
	zassert_equal(S.c.fault, MC_FAULT_ESTOP);
}

/* A NaN feed-forward must not become a full-scale current: 0 A and a fault at once. */
ZTEST(ctl, test_nan_in_the_servo_bank_trips_internal)
{
	mc_servo_bank *b = &S.b;
	mc_servo_cmd cmd = {.seq = 1, .on = true};
	double pos[MC_LEGS], cur[MC_LEGS];

	for (int i = 0; i < MC_LEGS; i++) {
		pos[i] = S.g.l0;
		cmd.prev[i] = S.g.l0;
		cmd.next[i] = S.g.l0;
		cmd.force[i] = 919.0;
	}
	cmd.force[3] = NAN;
	mc_bank_step(b, &cmd, pos, cur);
	zassert_equal(cur[3], 0.0);
	zassert_true(b->axis[3].invalid);
	zassert_false(b->axis[3].saturated);
	zassert_equal(b->fb.trip, MC_FAULT_INTERNAL);
	zassert_equal(b->fb.trip_leg, 3);
	zassert_equal(b->fb.leg_trip[3], MC_FAULT_INTERNAL);
	zassert_equal(b->fb.leg_trip[0], 0);
	zassert_true(isfinite(cur[0]) && (cur[0] > 0.0));
}
```

## src/test_filters.c
```c
/*
 * SPEC F04: Tustin biquads. The discrete response at e^{jW} must equal the
 * continuous prototype at the pre-warped frequency 2 fs tan(W / 2) (that is
 * what the bilinear transform is), and the poles must be inside the unit circle.
 */
#include <math.h>
#include <zephyr/ztest.h>

#include "mcue/filters.h"

#define FS 500.0

ZTEST_SUITE(filters, NULL, NULL, NULL, NULL, NULL);

typedef struct {
	double re, im;
} cplx;

static cplx cdiv(cplx a, cplx b)
{
	double d = (b.re * b.re) + (b.im * b.im);

	return (cplx){((a.re * b.re) + (a.im * b.im)) / d, ((a.im * b.re) - (a.re * b.im)) / d};
}

/* H(e^{jW}) of the section */
static cplx discrete(const mc_biquad *f, double W)
{
	cplx n = {f->b0 + (f->b1 * cos(W)) + (f->b2 * cos(2.0 * W)),
		  -(f->b1 * sin(W)) - (f->b2 * sin(2.0 * W))};
	cplx d = {1.0 + (f->a1 * cos(W)) + (f->a2 * cos(2.0 * W)),
		  -(f->a1 * sin(W)) - (f->a2 * sin(2.0 * W))};

	return cdiv(n, d);
}

/* (n2 s^2 + n1 s + n0) / (d2 s^2 + d1 s + d0) at s = j w */
static cplx continuous(const double n[3], const double d[3], double w)
{
	cplx num = {n[2] - (n[0] * w * w), n[1] * w};
	cplx den = {d[2] - (d[0] * w * w), d[1] * w};

	return cdiv(num, den);
}

static void check_response(const mc_biquad *f, const double n[3], const double d[3])
{
	static const double freqs[] = {0.3, 1.0, 10.0}; /* rad/s */

	for (size_t k = 0; k < ARRAY_SIZE(freqs); k++) {
		double W = freqs[k] / FS;
		double warped = 2.0 * FS * tan(W / 2.0);
		cplx hd = discrete(f, W);
		cplx hc = continuous(n, d, warped);
		double mag = sqrt((hc.re * hc.re) + (hc.im * hc.im));

		zassert_within(hd.re, hc.re, 1e-9 * (1.0 + mag), "re at %.1f rad/s", freqs[k]);
		zassert_within(hd.im, hc.im, 1e-9 * (1.0 + mag), "im at %.1f rad/s", freqs[k]);
	}
}

ZTEST(filters, test_hp2_matches_prototype)
{
	mc_biquad f;
	double wn = 1.0, z = 1.0;

	zassert_true(mc_biquad_hp2(&f, wn, z, FS));
	check_response(&f, (const double[]){1, 0, 0}, (const double[]){1, 2 * z * wn, wn * wn});
	/* DC blocked, unity at Nyquist */
	zassert_within((f.b0 + f.b1 + f.b2) / (1 + f.a1 + f.a2), 0.0, 1e-12);
	zassert_within((f.b0 - f.b1 + f.b2) / (1 - f.a1 + f.a2), 1.0, 1e-12);
}

ZTEST(filters, test_lp2_matches_prototype)
{
	mc_biquad f;
	double wn = 4.0, z = 1.0;

	zassert_true(mc_biquad_lp2(&f, wn, z, FS));
	check_response(&f, (const double[]){0, 0, wn * wn}, (const double[]){1, 2 * z * wn, wn * wn});
	zassert_within((f.b0 + f.b1 + f.b2) / (1 + f.a1 + f.a2), 1.0, 1e-12);
}

ZTEST(filters, test_hp1_matches_prototype)
{
	mc_biquad f;
	double wb = 1.0;

	/* a first-order section must be strictly stable, not a cancelled pole at z = -1 */
	zassert_true(mc_biquad_hp1(&f, wb, FS));
	zassert_equal(f.a2, 0.0);
	check_response(&f, (const double[]){0, 1, 0}, (const double[]){0, 1, wb});
}

ZTEST(filters, test_resonator_matches_prototype)
{
	mc_biquad f;

	zassert_true(mc_biquad_tustin(&f, 0, 0, 1, 1, 6, 9, FS));
	check_response(&f, (const double[]){0, 0, 1}, (const double[]){1, 6, 9});
}

ZTEST(filters, test_unstable_prototype_rejected)
{
	mc_biquad f;

	/* s^2 - 2 s + 4: poles in the right half plane map outside the unit circle */
	zassert_false(mc_biquad_tustin(&f, 0, 0, 4, 1, -2, 4, FS));
	zassert_false(mc_biquad_tustin(&f, 0, 0, 0, 0, 0, 0, FS)); /* degenerate */
}

ZTEST(filters, test_step_and_reset)
{
	mc_biquad f;

	zassert_true(mc_biquad_lp2(&f, 4.0, 1.0, FS));
	double y = 0.0;

	for (int k = 0; k < 5 * (int)FS; k++) {
		y = mc_biquad_step(&f, 1.0);
	}
	zassert_within(y, 1.0, 1e-6, "LP2 settles to its DC gain");
	mc_biquad_reset(&f);
	zassert_within(mc_biquad_step(&f, 0.0), 0.0, 0.0);
}
```

## src/test_kin.c
```c
/* SPEC F01, F02, F07 (statics): kinematics against the NumPy reference and first principles. */
#include <math.h>
#include <zephyr/ztest.h>

#include "kin_vectors.h"
#include "mcue/kin.h"
#include "mcue/platform_config.h"

static mc_geometry g;

static void *setup(void)
{
	mc_geometry_params p;

	mc_geometry_default_params(&p);
	zassert_true(mc_geometry_build(&g, &p));
	return NULL;
}

ZTEST_SUITE(kin, NULL, setup, NULL, NULL, NULL);

static mc_pose pose_of(const double v[6])
{
	return (mc_pose){v[0], v[1], v[2], v[3], v[4], v[5]};
}

static uint32_t rng_state = 12345U;

static double urand(double lo, double hi)
{
	rng_state ^= rng_state << 13;
	rng_state ^= rng_state >> 17;
	rng_state ^= rng_state << 5;
	return lo + ((hi - lo) * ((double)rng_state / 4294967295.0));
}

ZTEST(kin, test_geometry_matches_reference)
{
	zassert_within(g.l0, KIN_VEC_L0, 1e-12);
	zassert_within(g.l_max - g.l_min, MC_CFG_STROKE_M, 1e-12);
	zassert_within(g.soft_hi - g.soft_lo, MC_CFG_STROKE_M - (2.0 * MC_CFG_SOFT_MARGIN_M), 1e-12);
}

ZTEST(kin, test_invalid_geometry_rejected)
{
	mc_geometry_params p;
	mc_geometry tmp;

	mc_geometry_default_params(&p);
	p.soft_margin = p.stroke; /* margins larger than the stroke */
	zassert_false(mc_geometry_build(&tmp, &p));
	mc_geometry_default_params(&p);
	p.neutral_height = 0.0;
	zassert_false(mc_geometry_build(&tmp, &p));
}

ZTEST(kin, test_neutral_and_pure_heave_closed_form)
{
	double l[MC_LEGS];
	mc_pose q = {0};

	mc_ik(&g, &q, l);
	for (int i = 0; i < MC_LEGS; i++) {
		zassert_within(l[i], g.l0, 1e-12, "leg %d", i);
	}

	/* Pure heave: horizontal offset is unchanged, vertical becomes h0 + dz. */
	double dx = g.plat[0].x - g.base[0].x;
	double dy = g.plat[0].y - g.base[0].y;

	q.z = 0.05;
	mc_ik(&g, &q, l);
	for (int i = 0; i < MC_LEGS; i++) {
		zassert_within(l[i], sqrt((dx * dx) + (dy * dy) + pow(g.h0 + 0.05, 2)), 1e-12);
	}
}

ZTEST(kin, test_ik_matches_numpy_reference)
{
	for (size_t k = 0; k < ARRAY_SIZE(kin_vectors); k++) {
		mc_pose q = pose_of(kin_vectors[k].pose);
		double l[MC_LEGS];

		mc_ik(&g, &q, l);
		for (int i = 0; i < MC_LEGS; i++) {
			zassert_within(l[i], kin_vectors[k].legs[i], 1e-12, "%s leg %d",
				       kin_vectors[k].name, i);
		}
	}
}

ZTEST(kin, test_statics_matches_numpy_reference)
{
	mc_vec3 com = {MC_CFG_PAYLOAD_COM_X_M, MC_CFG_PAYLOAD_COM_Y_M, MC_CFG_PAYLOAD_COM_Z_M};

	for (size_t k = 0; k < ARRAY_SIZE(kin_vectors); k++) {
		mc_pose q = pose_of(kin_vectors[k].pose);
		double f[MC_LEGS];

		zassert_true(mc_statics(&g, &q, MC_CFG_PAYLOAD_KG, &com, f));
		for (int i = 0; i < MC_LEGS; i++) {
			zassert_within(f[i], kin_vectors[k].force[i], 1e-6, "%s leg %d",
				       kin_vectors[k].name, i);
		}
	}
}

ZTEST(kin, test_statics_neutral_by_hand)
{
	/* Symmetric: each leg carries m g / 6, divided by the cosine of its angle to vertical. */
	mc_vec3 com = {0.0, 0.0, 0.3};
	mc_pose q = {0};
	double f[MC_LEGS];

	zassert_true(mc_statics(&g, &q, 500.0, &com, f));
	for (int i = 0; i < MC_LEGS; i++) {
		zassert_within(f[i], (500.0 * MC_GRAVITY / 6.0) / (g.h0 / g.l0), 1e-9);
	}
}

ZTEST(kin, test_jacobian_matches_finite_differences)
{
	const double h = 1e-7;

	for (size_t k = 0; k < ARRAY_SIZE(kin_vectors); k++) {
		mc_pose q = pose_of(kin_vectors[k].pose);
		double J[MC_LEGS][6];

		mc_jacobian(&g, &q, J);
		for (int c = 0; c < 6; c++) {
			double qp[6], qm[6], lp[MC_LEGS], lm[MC_LEGS];

			for (int j = 0; j < 6; j++) {
				qp[j] = kin_vectors[k].pose[j];
				qm[j] = kin_vectors[k].pose[j];
			}
			qp[c] += h;
			qm[c] -= h;
			mc_pose a = pose_of(qp), b = pose_of(qm);

			mc_ik(&g, &a, lp);
			mc_ik(&g, &b, lm);
			for (int i = 0; i < MC_LEGS; i++) {
				zassert_within(J[i][c], (lp[i] - lm[i]) / (2.0 * h), 1e-6,
					       "%s J[%d][%d]", kin_vectors[k].name, i, c);
			}
		}
	}
}

ZTEST(kin, test_fk_round_trip_1000_random_poses)
{
	int worst_iter = 0;

	for (int n = 0; n < 1000; n++) {
		mc_pose truth = {urand(-0.15, 0.15), urand(-0.15, 0.15), urand(-0.10, 0.10),
				 urand(-0.17, 0.17), urand(-0.17, 0.17), urand(-0.35, 0.35)};
		double l[MC_LEGS];
		mc_pose q = {0}; /* cold start from neutral */
		mc_fk_info info;

		mc_ik(&g, &truth, l);
		zassert_true(mc_fk(&g, l, &q, 10, 1e-12, &info), "pose %d did not converge", n);
		zassert_within(q.x, truth.x, 1e-9);
		zassert_within(q.y, truth.y, 1e-9);
		zassert_within(q.z, truth.z, 1e-9);
		zassert_within(q.roll, truth.roll, 1e-9);
		zassert_within(q.pitch, truth.pitch, 1e-9);
		zassert_within(q.yaw, truth.yaw, 1e-9);
		worst_iter = MAX(worst_iter, info.iterations);
	}
	TC_PRINT("FK cold start from neutral: worst case %d iterations\n", worst_iter);
}

ZTEST(kin, test_fk_warm_start_meets_spec)
{
	/* SPEC F02: from the last pose (one 2 ms cueing step away) within 6 iterations to 1e-6. */
	for (size_t k = 0; k < ARRAY_SIZE(kin_vectors); k++) {
		mc_pose truth = pose_of(kin_vectors[k].pose);
		mc_pose q = truth;
		double l[MC_LEGS];
		mc_fk_info info;

		/* last pose: 1 mm and 0.1 deg away on every axis (more than one cycle at full speed) */
		q.x -= 0.001;
		q.y += 0.001;
		q.z -= 0.001;
		q.roll += 0.00175;
		q.pitch -= 0.00175;
		q.yaw += 0.00175;
		mc_ik(&g, &truth, l);
		zassert_true(mc_fk(&g, l, &q, 6, 1e-6, &info), "%s", kin_vectors[k].name);
		zassert_true(info.iterations <= 3, "%s took %d iterations", kin_vectors[k].name,
			     info.iterations);
		zassert_true(info.residual < 1e-9);
	}
}

/* fmax() ignores NaN: a NaN leg length must not come back as a converged pose. */
ZTEST(kin, test_fk_rejects_non_finite_legs)
{
	const mc_pose start = {0.01, -0.02, 0.03, 0.01, 0.02, -0.03};
	double l[MC_LEGS];
	mc_pose q = start;
	mc_fk_info info;

	mc_ik(&g, &start, l);
	l[3] = NAN;
	zassert_false(mc_fk(&g, l, &q, 30, 1e-9, &info));
	zassert_false(info.converged);
	zassert_false(isfinite(info.residual));
	zassert_true(isfinite(q.x) && isfinite(q.roll) && isfinite(q.yaw), "NaN pose returned");
	zassert_equal(q.x, start.x, "pose restored to the start");
	zassert_equal(q.yaw, start.yaw);
}

/* Leg lengths no pose produces: not converged, whatever the last step was. */
ZTEST(kin, test_fk_unreachable_legs_not_converged)
{
	double l[MC_LEGS];
	mc_pose q = {0};
	mc_fk_info info;

	/*
	 * Every leg 50 mm: the joints of legs 1 and 2 are 0.333 m apart on the base
	 * and 0.5 m apart on the platform, so 2 x 50 mm of leg cannot bridge them.
	 */
	for (int i = 0; i < MC_LEGS; i++) {
		l[i] = 0.05;
	}
	bool ok = mc_fk(&g, l, &q, 30, 1e-9, &info);

	TC_PRINT("unreachable legs: converged %d after %d iterations, residual %.3g m\n", ok,
		 info.iterations, info.residual);
	zassert_false(ok);
	zassert_true(info.residual > 1e-9);
}
```

## src/test_linalg.c
```c
/* 6x6 solver used by forward kinematics and statics. */
#include <zephyr/ztest.h>

#include "mcue/linalg.h"

ZTEST_SUITE(linalg, NULL, NULL, NULL, NULL, NULL);

ZTEST(linalg, test_solves_a_system_needing_pivoting)
{
	/* Zero on the first diagonal element forces a row swap. */
	const double A[6][6] = {
		{0, 2, 1, 0, 0, 1}, {3, 1, 0, 2, 0, 0}, {1, 0, 4, 1, 1, 0},
		{0, 1, 1, 5, 0, 2}, {2, 0, 0, 1, 6, 1}, {1, 1, 0, 0, 1, 7},
	};
	const double x_true[6] = {1, -2, 3, -4, 5, -6};
	double b[6] = {0};
	double x[6];

	for (int r = 0; r < 6; r++) {
		for (int c = 0; c < 6; c++) {
			b[r] += A[r][c] * x_true[c];
		}
	}
	zassert_true(mc_solve6(A, b, x));
	for (int i = 0; i < 6; i++) {
		zassert_within(x[i], x_true[i], 1e-12);
	}
}

ZTEST(linalg, test_singular_matrix_is_reported)
{
	double A[6][6] = {{0}};
	const double b[6] = {1, 1, 1, 1, 1, 1};
	double x[6];

	for (int i = 0; i < 6; i++) {
		A[i][0] = 1.0; /* rank 1 */
	}
	zassert_false(mc_solve6(A, b, x));
}
```

## src/test_proto.c
```c
/*
 * SPEC F09, F10: CAN payloads against vectors encoded from protocol/motion.dbc.
 */
#include <math.h>
#include <string.h>
#include <zephyr/ztest.h>

#include "proto.h"
#include "proto_vectors.h"

#ifndef M_PI
#define M_PI 3.14159265358979323846
#endif

ZTEST_SUITE(proto, NULL, NULL, NULL, NULL, NULL);

static void same(const uint8_t *a, const uint8_t *b, size_t n, const char *what)
{
	for (size_t i = 0; i < n; i++) {
		zassert_equal(a[i], b[i], "%s byte %zu: 0x%02x != 0x%02x (DBC)", what, i, a[i], b[i]);
	}
}

ZTEST(proto, test_ids_match_the_dbc)
{
	zassert_equal(PROTO_ID_VEHICLE_F, VEC_VEHICLE_F_ID);
	zassert_equal(PROTO_ID_VEHICLE_W, VEC_VEHICLE_W_ID);
	zassert_equal(PROTO_ID_CMD, VEC_CMD_SET_ID);
	zassert_equal(PROTO_ID_CMD_ACK, VEC_CMD_ACK_ID);
	zassert_equal(PROTO_ID_FAULT, VEC_FAULT_ID);
	zassert_equal(PROTO_ID_STATUS, VEC_STATUS_ID);
	zassert_equal(PROTO_ID_POSE_T, VEC_POSE_T_ID);
	zassert_equal(PROTO_ID_POSE_R, VEC_POSE_R_ID);
	zassert_equal(PROTO_ID_LEG_POS_A, VEC_LEG_POS_A_ID);
	zassert_equal(PROTO_ID_LEG_CUR_B, VEC_LEG_CUR_B_ID);
	zassert_equal(PROTO_ID_TIMING, VEC_TIMING_ID);
}

ZTEST(proto, test_vehicle_state_round_trip)
{
	uint8_t b[8];
	double f[3], w[3];
	uint16_t seq;
	const double f_in[3] = {1.5, -2.25, 9.81};
	const double w_in[3] = {0.125, -0.05, 0.3};

	zassert_equal(proto_encode_vehicle_f(f_in, 42, b), 8);
	same(b, VEC_VEHICLE_F, 8, "VEHICLE_F");
	zassert_true(proto_decode_vehicle_f(VEC_VEHICLE_F, 8, f, &seq));
	zassert_equal(seq, 42);
	for (int i = 0; i < 3; i++) {
		zassert_within(f[i], f_in[i], 0.001);
	}
	zassert_equal(proto_encode_vehicle_w(w_in, 65535, b), 8);
	same(b, VEC_VEHICLE_W, 8, "VEHICLE_W");
	zassert_true(proto_decode_vehicle_w(VEC_VEHICLE_W, 8, w, &seq));
	zassert_equal(seq, 65535);
	for (int i = 0; i < 3; i++) {
		zassert_within(w[i], w_in[i], 0.00005);
	}
	zassert_false(proto_decode_vehicle_f(VEC_VEHICLE_F, 7, f, &seq), "short frame");

	/* saturation: a 7 g cue clips at the scale limit instead of wrapping */
	const double big[3] = {70.0, -70.0, 0.0};

	(void)proto_encode_vehicle_f(big, 0, b);
	zassert_true(proto_decode_vehicle_f(b, 8, f, &seq));
	zassert_within(f[0], 65.534, 1e-9);
	zassert_within(f[1], -65.536, 1e-9);
}

ZTEST(proto, test_cmd_and_ack)
{
	struct proto_cmd c;
	uint8_t b[8];

	zassert_true(proto_decode_cmd(VEC_CMD_SET, 7, &c));
	zassert_equal(c.opcode, PROTO_OP_SET_PARAM);
	zassert_equal(c.key, 1);
	zassert_equal(c.value, 450);
	zassert_equal(proto_encode_cmd(&c, b), 7);
	same(b, VEC_CMD_SET, 7, "CMD");

	zassert_true(proto_decode_cmd(VEC_CMD_NEG, 7, &c));
	zassert_equal(c.value, -1);

	const uint8_t not_sf[8] = {0x10, 0x06, 5, 1, 0, 0, 0, 0};

	zassert_false(proto_decode_cmd(not_sf, 8, &c), "first frame, not a single frame");
	zassert_false(proto_decode_cmd(VEC_CMD_SET, 6, &c), "short");

	const struct proto_cmd_ack a = {.opcode = 6, .key = 1, .status = 0, .value = 450};
	struct proto_cmd_ack a2;

	zassert_equal(proto_encode_cmd_ack(&a, b), 8);
	same(b, VEC_CMD_ACK, 8, "CMD_ACK");
	zassert_true(proto_decode_cmd_ack(b, 8, &a2));
	zassert_equal(a2.value, 450);
}

ZTEST(proto, test_status_frames)
{
	uint8_t b[8];
	const struct proto_fault f = {.code = 1, .leg = 3, .state = 6, .count = 2, .value = -5123};
	const struct proto_status s = {.state = 4, .saturated = true, .fk_ok = true,
				       .comms_lost = true, .ws_scale = 0.41, .event = 7,
				       .seq = 1000};
	const struct proto_timing t = {312, 1450, 0, 2};
	const double xyz[3] = {0.0825, -0.0005, 0.07};
	const double rpy[3] = {5.25 * M_PI / 180.0, -8.75 * M_PI / 180.0, 2.5 * M_PI / 180.0};
	const double stroke[3] = {0.01, 0.125, 0.24};
	const double cur[3] = {2.95, -0.97, 20.0};

	(void)proto_encode_fault(&f, b);
	same(b, VEC_FAULT, 8, "FAULT");
	(void)proto_encode_status(&s, b);
	same(b, VEC_STATUS, 8, "STATUS");
	(void)proto_encode_pose_t(xyz, 5, b);
	same(b, VEC_POSE_T, 8, "POSE_T");
	(void)proto_encode_pose_r(rpy, 5, b);
	same(b, VEC_POSE_R, 8, "POSE_R");
	(void)proto_encode_leg_pos(stroke, 7, b);
	same(b, VEC_LEG_POS_A, 8, "LEG_POS_A");
	(void)proto_encode_leg_cur(cur, 7, b);
	same(b, VEC_LEG_CUR_B, 8, "LEG_CUR_B");
	(void)proto_encode_timing(&t, b);
	same(b, VEC_TIMING, 8, "TIMING");

	/* a leg resting on the stop (tiny negative stroke) reads 0, not 65535 */
	const double low[3] = {-1e-7, 0.0, 0.7};

	(void)proto_encode_leg_pos(low, 0, b);
	zassert_equal(b[0] | (b[1] << 8), 0);
	zassert_equal(b[4] | (b[5] << 8), 65535, "saturates high");
}
```
